## arch/x86/configs/defconfig
```kconfig
CONFIG_X86=y
CONFIG_BOOTLOADER=y
CONFIG_DEBUG_BOOTLOADER=y
CONFIG_RAMDISK=y
CONFIG_HARDDISK=y
CONFIG_DEBUG_KERNEL=y
CONFIG_GDB=y
CONFIG_EMULATE_RUNNING_SYSTEM=y
CONFIG_QEMU=y
CONFIG_QEMU_BOOT_FLOPPY=y
CONFIG_QEMU_MEMORY_SIZE=16
CONFIG_QEMU_ROOTFS_NAME="BiscuitOS.img"
```
